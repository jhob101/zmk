## app/dts/bindings/behaviors/zmk,behavior-joystick-button.yaml
```yaml
# Copyright (c) 2026 The ZMK Contributors
# SPDX-License-Identifier: MIT

description: Joystick button press/release behavior. The parameter is the button index, from 0.

compatible: "zmk,behavior-joystick-button"

include: one_param.yaml
```

## app/dts/bindings/behaviors/zmk,behavior-joystick-dpad.yaml
```yaml
# Copyright (c) 2026 The ZMK Contributors
# SPDX-License-Identifier: MIT

description: |
  Joystick D-pad direction behavior. Drives the X and Y axes to their limits.
  The parameter is one of JD_LEFT, JD_RIGHT, JD_UP, JD_DOWN.

compatible: "zmk,behavior-joystick-dpad"

include: one_param.yaml
```

## app/dts/bindings/behaviors/zmk,behavior-scroll-hold.yaml
```yaml
# Copyright (c) 2026 The ZMK Contributors
# SPDX-License-Identifier: MIT

description: |
  Hold to scroll with the trackpad. Released without any trackpad motion, it
  taps the bound behavior instead. With `toggle` it is a scroll switch.

compatible: "zmk,behavior-scroll-hold"

include: zero_param.yaml

properties:
  bindings:
    type: phandle-array
    required: true
    description: The single behavior to tap when the key is released unused.
  tap-ms:
    type: int
    default: 30
    description: How long the tapped behavior is held before it is released.
  pass-through:
    type: boolean
    description: |
      Press the bound behavior when the key goes down and release it when the
      key comes up, as well as scrolling, instead of tapping it on release.
  toggle:
    type: boolean
    description: |
      Make the key a scroll switch: each press turns trackpad scrolling on or
      off, and it stays that way until the next press. The bound behavior is
      not tapped, so bind &none unless pass-through is also set.
```

## app/dts/bindings/behaviors/zmk,behavior-sticky-key.yaml
```yaml
# Copyright (c) 2020 The ZMK Contributors
# SPDX-License-Identifier: MIT

description: Sticky key behavior

compatible: "zmk,behavior-sticky-key"

include: one_param.yaml

properties:
  bindings:
    type: phandles
    required: true
  release-after-ms:
    type: int
    required: true
  quick-release:
    type: boolean
  ignore-modifiers:
    type: boolean
  cancel-on-retap:
    type: boolean
    description: |
      Tapping the key again while it is armed and unused disarms it, instead
      of arming it afresh.
  release-on-mouse:
    type: boolean
    description: |
      A mouse click or a trackpad scroll uses up the armed key, as a key press
      does. Without this, only key presses use it up.
```

## app/dts/bindings/behaviors/zmk,behavior-trackpad-enable.yaml
```yaml
# Copyright (c) 2026 The ZMK Contributors
# SPDX-License-Identifier: MIT

description: |
  Switch the trackpad's cursor and scroll output on or off. The parameter is
  1 for on, 0 for off. Not saved: the trackpad is always on after power-up.

compatible: "zmk,behavior-trackpad-enable"

include: one_param.yaml
```

## app/dts/bindings/behaviors/zmk,behavior-trackpad-lift.yaml
```yaml
# Copyright (c) 2026 The ZMK Contributors
# SPDX-License-Identifier: MIT

description: |
  Switch trackpad lift detection on or off. The parameter is 1 for on, 0 for
  off. The choice is saved, and kept across power cycles and firmware updates.

compatible: "zmk,behavior-trackpad-lift"

include: one_param.yaml
```

## app/dts/bindings/behaviors/zmk,behavior-trackpad-light.yaml
```yaml
# Copyright (c) 2026 The ZMK Contributors
# SPDX-License-Identifier: MIT

description: |
  Control the trackpad light. The parameter is TPL_OFF, TPL_ON or TPL_TOG
  (saved across power cycles), or TPL_SUSPEND and TPL_RESUME, which hold it
  off and let it go again without changing the saved choice (for a lock).
  See dt-bindings/zmk/trackpad.h.

compatible: "zmk,behavior-trackpad-light"

include: one_param.yaml
```
